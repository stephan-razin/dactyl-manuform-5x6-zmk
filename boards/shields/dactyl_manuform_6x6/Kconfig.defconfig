## boards/shields/dactyl_manuform_6x6/Kconfig.defconfig
```kconfig
if SHIELD_DACTYL_MANUFORM_6X6_LEFT

    config ZMK_KEYBOARD_NAME
        default "Dactyl BLEl"

    config ZMK_SPLIT_ROLE_CENTRAL
        default y

endif


if SHIELD_DACTYL_MANUFORM_6X6_RIGHT

    config ZMK_KEYBOARD_NAME
        default "Dactyl BLEr"

endif


if SHIELD_DACTYL_MANUFORM_6X6_LEFT || SHIELD_DACTYL_MANUFORM_6X6_RIGHT 

config ZMK_SPLIT
    default y

endif
```
